//
// Created by pranshu on 26/1/18.
//

//#include <iostream>
//#include <Eigen/Dense>
//#include <Eigen/Sparse>

using namespace std;

class Bonsai_fp
{
    int Projected_Dimension, Original_Dimension, Tree_Height, Number_Of_Labels;
    float sigma, ***W_fp, ***V_fp, **Z_fp, **Theta_fp;

public:
    Bonsai_fp(int pd,int od, int th, int nl, float sg, float ***W,float ***V,float **Z,float **T)
    {
        Projected_Dimension = pd;
        Original_Dimension = od;
        Tree_Height = th;
        Number_Of_Labels = nl;
        sigma = sg;
        W_fp = W;
        V_fp = V;
        Z_fp = Z;
        Theta_fp = T;
    }
    float* Get_Score(float *Original_Data_Point_fp, bool mode)
    {
        int i,j,k,Current_Node=0;
        float *Score_fp,a,b,Sum;
        Score_fp = (float*)malloc(Number_Of_Labels*sizeof(float));
        memset(Score_fp,0,Number_Of_Labels*sizeof(float));
        if(mode)
        {
            float *Projected_Data_Point_fp;
            Projected_Data_Point_fp = (float*)malloc(Projected_Dimension*sizeof(float*));
            memset(Projected_Data_Point_fp,0,Projected_Dimension*sizeof(float));
            for(i=0;i<Projected_Dimension;i++)
            {
                for(j=0;j<Original_Dimension;j++)
                    Projected_Data_Point_fp[i] += Z_fp[i][j] * Original_Data_Point_fp[j];
            }		

            for(i=0;i<Tree_Height;i++)
            {
                for(j=0;j<Number_Of_Labels;j++)
                {
                    a = 0;
                    b = 0;
                    for(k=0;k<Projected_Dimension;k++)
                    {
                        a += W_fp[Current_Node][k][j] * Projected_Data_Point_fp[k];
                        b += V_fp[Current_Node][k][j] * Projected_Data_Point_fp[k];
                    }
                    Score_fp[j] += a * tanh(sigma * b);
                }
                Sum = 0;
                for(j=0;j<Projected_Dimension;j++)
                    Sum += Theta_fp[Current_Node][j]*Projected_Data_Point_fp[j];
                Current_Node = (Sum > 0)? Current_Node * 2 + 1: Current_Node * 2 + 2;
            }
            for(j=0;j<Number_Of_Labels;j++)
            {
                a = 0;
                b = 0;
                for(k=0;k<Projected_Dimension;k++)
                {
                    a += W_fp[Current_Node][k][j] * Projected_Data_Point_fp[k];
                    b += V_fp[Current_Node][k][j] * Projected_Data_Point_fp[k];
                }
                Score_fp[j] += a * tanh(sigma * b);
            }
        }
        else
        {
            for(i=0;i<Tree_Height;i++)
            {
                for(j=0;j<Number_Of_Labels;j++)
                {
                    a = 0;
                    b = 0;
                    for(k=0;k<Projected_Dimension;k++)
                    {
                        a += W_fp[Current_Node][k][j] * Original_Data_Point_fp[k];
                        b += V_fp[Current_Node][k][j] * Original_Data_Point_fp[k];
                    }
                    Score_fp[j] += a * tanh(sigma * b);
                }
                Sum = 0;
                for(j=0;j<Projected_Dimension;j++)
                    Sum += Theta_fp[Current_Node][j]*Original_Data_Point_fp[j];
                Current_Node = (Sum > 0)? Current_Node * 2 + 1: Current_Node * 2 + 2;
            }
            for(j=0;j<Number_Of_Labels;j++)
            {
                a = 0;
                b = 0;
                for(k=0;k<Projected_Dimension;k++)
                {
                    a += W_fp[Current_Node][k][j] * Original_Data_Point_fp[k];
                    b += V_fp[Current_Node][k][j] * Original_Data_Point_fp[k];
                }
                Score_fp[j] += a * tanh(sigma * b);
            }
        }
		for(j=0;j<Number_Of_Labels;j++)
            Serial.println(Score_fp[j]);
        //for(j=0;j<Number_Of_Labels;j++)
        //    cout<<Score_fp[j]<<endl;
        return Score_fp;
    }
};

float buffer[] = {0.4791,-0.0926,-0.4095,-0.1686,0.0720,-0.2004,0.0386,-0.3430,-0.0458,-0.3186,0.0539,-0.0595,0.0775,0.3160,-0.4333,-0.0188,-0.0083,-0.2077,-0.1463,0.3219,0.3281,
-0.1455,0.2468,0.1120,0.0402,-0.2114,0.1093,0.1196,-0.3561,0.1500,-0.1586,-0.2927,0.2071,0.2532,-0.0770,0.1931,0.0245,0.3149,-0.3928,0.0592,-0.0621,
0.1300,0.3611,0.1961,0.5477,0.2195,-0.2609,-0.4278,-0.1362,0.0429,-0.2323,0.0552,-0.3399,-0.0640,-0.0463,0.3812,0.3421,0.4478,0.0941,-0.5063,-0.4050,
-0.1631,-0.2166,0.3543,0.1747,-0.2513,0.2392,-0.2062,0.0078,0.2550,-0.0169,-0.1228,0.0882,0.2532,-0.3810,0.1665,-0.2314,0.1719,0.3033,-0.1702,0.0100,
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-0.0107,-0.0098,-0.0080,-0.0058,-0.0041,-0.0041,0.0000,0.0000,0.0000,0.0000,0.0000,0.0000};

int Projected_Dimension=3, Original_Dimension=785, Tree_Height=1, Number_Of_Labels=10, i, j, k, Predicted_Label, ctr=0;
float sigma = 4;
int Internal_Nodes = pow(2,Tree_Height)-1;
int Total_Nodes = pow(2,Tree_Height+1)-1;



#ifndef ARDUINOCODES_BONSAI_CLASS_H
#define ARDUINOCODES_BONSAI_CLASS_H

#endif //ARDUINOCODES_BONSAI_CLASS_H
